## Kconfig
```kconfig
# Copyright (c) 2024 Federico (MrPinko)
# SPDX-License-Identifier: MIT

config ZMK_BEHAVIOR_OLED_TOGGLE
    bool "OLED display toggle behavior"
    depends on ZMK_DISPLAY
    default y

config ZMK_BEHAVIOR_OLED_GIF_CYCLE
    bool "OLED image/GIF cycle behavior"
    depends on ZMK_DISPLAY
    default y
```

## dts/bindings/behaviors/zmk,behavior-oled-gif-cycle.yaml
```yaml
# Copyright (c) 2024 Federico (MrPinko)
# SPDX-License-Identifier: MIT

description: |
  OLED image / animated GIF cycle behavior.
  Pressing this key cycles to the next image or animated GIF on the OLED.
  Uses BEHAVIOR_LOCALITY_GLOBAL so both halves of a split keyboard respond.

compatible: "zmk,behavior-oled-gif-cycle"

include: one_param.yaml
```

## dts/bindings/behaviors/zmk,behavior-oled-toggle.yaml
```yaml
# Copyright (c) 2024 Federico (MrPinko)
# SPDX-License-Identifier: MIT

description: |
  OLED display toggle behavior.
  Pressing this key will turn the OLED display on or off.
  Use BEHAVIOR_LOCALITY_GLOBAL so both halves of a split
  keyboard respond to the toggle together.

compatible: "zmk,behavior-oled-toggle"

include: zero_param.yaml
```
